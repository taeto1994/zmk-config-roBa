## config/west.yml
```yaml
# config/west.yml のイメージ
manifest:
  remotes:
    - name: zmkfirmware
      url-base: https://github.com/zmkfirmware
  projects:
    - name: zmk
      remote: zmkfirmware
      revision: main  # ← ここを main に変更（あるいは最新のタグに変更）
      import: app/west.yml
```
